## codriving/hypes_yaml/codriving/sample.yaml
```yaml
common: {}

data:
  dataset:
    type: "CarlaMVDatasetWithGTInput"
    root: "./data"
    towns: [1, 2, 3, 4]
    weathers: [0, 1, 2, 3, 4, 5, 6, 7, 8, 9, 10, 11, 12, 13]
    input_frame: 5
    output_points: 10
    det_range: [36, 12, 12, 12, 0.125]
  dataloader:
    type: "DataLoader"
    batch_size: 128
    num_workers: 16

model:
  planner:
    type: "WaypointPlanner"
    # TODO: other hyper-parameters

model_decoration:
  clip_grad: 10

loss:
  type: "CompoundLoss"
  loss_configs:
  - type: "WaypointL1Loss"
  - config: {}
  - weight: 1.0

training:
  epochs: &EPOCHS 50
  log_interval: 50

  optimizer:
    type: "AdamW"
    lr: 0.0005
    # TODO (yinda): add learning rate configuration with REGEX
    # --with-backbone-lr --backbone-lr 0.0002 \
    weight_decay: 0.05
    eps: 1.0e-8
  lr_scheduler:
    type: 'CosineAnnealingLR'
    T_max: *EPOCHS
    eta_min: 1.0e-6  # TODO (yinda) verify this number in CoP3
```
